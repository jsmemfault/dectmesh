## CMakeLists.txt
```
#
# Copyright (c) 2026 Jon Sharp
#
# SPDX-License-Identifier: Apache-2.0
#

cmake_minimum_required(VERSION 3.20.0)

find_package(Zephyr REQUIRED HINTS $ENV{ZEPHYR_BASE})
project(dect_nrplus_mesh)

# Memfault picks up memfault_platform_config.h and
# memfault_metrics_heartbeat_config.def from this directory.
zephyr_include_directories(config)

target_sources(app PRIVATE
	src/main.c
	src/dect_phy.c
	src/mesh.c
	src/mesh_metrics.c
)
```

## Kconfig
```
#
# Copyright (c) 2026 Jon Sharp
#
# SPDX-License-Identifier: Apache-2.0
#

menu "DECT NR+ Mesh"

config DECT_MESH_CARRIER
	int "DECT NR+ carrier (channel) number"
	default 0
	help
	  Channel availability and the rules for using it vary by country and
	  region. See ETSI TS 103 636-2 section 5.4.2 for the calculation. A
	  value of 0 fails the build on purpose: set the carrier deliberately
	  for your region (see overlay-eu.conf and overlay-us.conf).

config DECT_MESH_NETWORK_ID
	int "DECT NR+ network ID"
	range 1 4294967295
	default 91
	help
	  Network identifier shared by all nodes in the mesh. Only frames whose
	  short network ID matches are received.

config DECT_MESH_MCS
	int "Modulation and coding scheme (MCS) index"
	range 0 4
	default 1
	help
	  Higher MCS values carry more data per subslot at the cost of range
	  and robustness.

config DECT_MESH_TX_POWER
	int "Transmit power index"
	range 0 13
	default 13
	help
	  Transmit power setting. See table 6.2.1-3 of ETSI TS 103 636-4. Lower
	  values for bench testing reduce interference between nearby nodes.

config DECT_MESH_NODE_ID
	int "Mesh node ID (0 derives the ID from the hardware ID)"
	range 0 65535
	default 0
	help
	  Address of this node in the mesh. Leave at 0 to derive a unique ID
	  from the device hardware ID, or set a small fixed value to make a
	  multi-node test topology easier to read in the logs.

config DECT_MESH_DEFAULT_TTL
	int "Default message time-to-live in hops"
	range 1 16
	default 4
	help
	  Maximum number of hops an originated message may travel before nodes
	  stop relaying it.

config DECT_MESH_ORIGINATE_INTERVAL_SECONDS
	int "Interval between originated messages in seconds (0 relays only)"
	range 0 3600
	default 10
	help
	  How often this node originates a broadcast message. Set to 0 for a
	  relay-only node that forwards traffic but never originates its own.

config DECT_MESH_RX_WINDOW_SECONDS
	int "Receive window duration in seconds"
	range 1 60
	default 3
	help
	  Duration of each continuous receive window between transmit bursts.

config DECT_MESH_DEDUP_CACHE_SIZE
	int "Duplicate-suppression cache size in entries"
	range 4 256
	default 32
	help
	  Number of recently seen (source, message) pairs remembered to stop
	  relay loops. Size it above the number of messages in flight across the
	  mesh within one TTL lifetime.

config DECT_MESH_MAX_NEIGHBORS
	int "Maximum tracked one-hop neighbors"
	range 1 64
	default 16

config DECT_MESH_NEIGHBOR_TIMEOUT_SECONDS
	int "Neighbor inactivity timeout in seconds"
	range 1 3600
	default 60
	help
	  A neighbor not heard from within this time is excluded from the active
	  neighbor count.

config DECT_MESH_RX_QUEUE_DEPTH
	int "Inbound frame queue depth in frames"
	range 2 64
	default 8

config DECT_MESH_TX_QUEUE_DEPTH
	int "Outbound frame queue depth in frames"
	range 2 64
	default 8

module = DECT_MESH
module-str = DECT NR+ Mesh
source "$(ZEPHYR_BASE)/subsys/logging/Kconfig.template.log_config"

endmenu

menu "Zephyr Kernel"
source "Kconfig.zephyr"
endmenu
```

## prj.conf
```kconfig
#
# Copyright (c) 2026 Jon Sharp
#
# SPDX-License-Identifier: Apache-2.0
#

# --- Modem and DECT NR+ PHY ------------------------------------------------
CONFIG_NRF_MODEM_LIB=y
CONFIG_NRF_MODEM_LINK_BINARY_DECT_PHY=y
CONFIG_MODEM_ANTENNA=n
CONFIG_HWINFO=y

# Non-secure target: build as a non-secure image with TF-M (minimal profile).
CONFIG_TFM_PROFILE_TYPE_MINIMAL=y

# --- System ----------------------------------------------------------------
CONFIG_FPU=y
CONFIG_ASSERT=y
CONFIG_HEAP_MEM_POOL_SIZE=8192
CONFIG_MAIN_STACK_SIZE=4096

# --- Logging and shell -----------------------------------------------------
CONFIG_LOG=y
CONFIG_LOG_BUFFER_SIZE=4096
CONFIG_SHELL=y

# --- Memfault --------------------------------------------------------------
CONFIG_MEMFAULT=y

# Paste your project key (Settings -> General in the Memfault app). Required
# only for uploading the exported chunks; collection works without it.
CONFIG_MEMFAULT_NCS_PROJECT_KEY=""

# Device identity shown in the fleet.
CONFIG_MEMFAULT_NCS_DEVICE_ID_RUNTIME=y
CONFIG_MEMFAULT_NCS_FW_TYPE="dect-nrplus-mesh"
CONFIG_MEMFAULT_NCS_FW_VERSION_STATIC=y
CONFIG_MEMFAULT_NCS_FW_VERSION="0.1.0"
CONFIG_MEMFAULT_NCS_HW_VERSION="nrf9151dk"

# A DECT NR+ PHY node has no IP stack, so Memfault data cannot be posted over
# HTTP. Disable the HTTP transport and export chunks over the shell instead
# (mflt export), or relay them to a gateway node. See the README.
CONFIG_MEMFAULT_HTTP_ENABLE=n

# Memfault shell: mflt export, mflt test, metrics_dump, get_core, ...
CONFIG_MEMFAULT_SHELL=y

# RAM-backed coredump keeps the example self-contained (no flash partition).
CONFIG_MEMFAULT_RAM_BACKED_COREDUMP=y
CONFIG_MEMFAULT_RAM_BACKED_COREDUMP_SIZE=8192
CONFIG_MEMFAULT_COREDUMP_COLLECT_BSS_REGIONS=y

# Capture firmware logs alongside coredumps and metrics.
CONFIG_MEMFAULT_LOGGING_ENABLE=y

# Short heartbeat interval for the demo. A production fleet typically aggregates
# metrics over a longer interval (for example, 3600 seconds).
CONFIG_MEMFAULT_METRICS_HEARTBEAT_INTERVAL_SECS=60

# Built-in stack/heap diagnostics.
CONFIG_MEMFAULT_NCS_STACK_METRICS=y
CONFIG_MEMFAULT_HEAP_STATS=y
```

## overlay-eu.conf
```kconfig
#
# Copyright (c) 2026 Jon Sharp
#
# SPDX-License-Identifier: Apache-2.0
#
# EU DECT band carrier. Only operate on the DECT band if you are permitted to
# and can ensure local access rules are met; otherwise prevent radio emissions
# (for example, with an RF chamber).
#
CONFIG_DECT_MESH_CARRIER=1677
```

## overlay-us.conf
```kconfig
#
# Copyright (c) 2026 Jon Sharp
#
# SPDX-License-Identifier: Apache-2.0
#
# US DECT band carrier and a reduced transmit power. Only operate on the DECT
# band if you are permitted to and can ensure local access rules are met;
# otherwise prevent radio emissions (for example, with an RF chamber).
#
CONFIG_DECT_MESH_CARRIER=1711
CONFIG_DECT_MESH_TX_POWER=10
```

## src/main.c
```c
/*
 * Copyright (c) 2026 Jon Sharp
 *
 * SPDX-License-Identifier: Apache-2.0
 *
 * DECT NR+ mesh node: bring up the PHY, then run the transmit/receive cadence
 * that drives the controlled-flood mesh. Each loop iteration drains any pending
 * inbound frames and originations, transmits queued outbound frames, then opens
 * a receive window to collect the next batch.
 */

#include "dect_phy.h"
#include "mesh.h"
#include "mesh_metrics.h"

#include <zephyr/kernel.h>
#include <zephyr/logging/log.h>

LOG_MODULE_REGISTER(main, CONFIG_DECT_MESH_LOG_LEVEL);

int main(void)
{
	int err;
	uint16_t phy_device_id;
	uint16_t node_id;
	uint8_t frame[MESH_FRAME_MAX];
	size_t len;

	LOG_INF("DECT NR+ mesh node starting");

	err = dect_phy_init(&phy_device_id);
	if (err) {
		LOG_ERR("DECT NR+ PHY init failed, err %d", err);
		return err;
	}

	/* A configured node ID overrides the hardware-derived PHY ID. */
	node_id = (CONFIG_DECT_MESH_NODE_ID != 0) ? CONFIG_DECT_MESH_NODE_ID : phy_device_id;

	mesh_metrics_set_device_id(node_id);
	mesh_init(node_id);
	dect_phy_set_rx_cb(mesh_rx_enqueue);

	while (1) {
		/* Process the previous window's inbound frames and originate. */
		mesh_process();

		/* Transmit everything the mesh queued (originations and relays). */
		while ((len = mesh_tx_dequeue(frame, sizeof(frame))) > 0) {
			err = dect_phy_tx(frame, len);
			if (err) {
				LOG_ERR("Transmit failed, err %d", err);
				mesh_metrics_record_tx_failure();
			}
		}

		/* Listen for inbound frames for the configured window. */
		err = dect_phy_rx_window(CONFIG_DECT_MESH_RX_WINDOW_SECONDS);
		if (err) {
			LOG_ERR("Receive window failed, err %d", err);
			return err;
		}
	}

	return 0;
}
```

## src/dect_phy.c
```c
/*
 * Copyright (c) 2026 Jon Sharp
 *
 * SPDX-License-Identifier: Apache-2.0
 *
 * DECT NR+ PHY wrapper. The init/configure/activate handshake and the operation
 * cadence follow the nRF Connect SDK "DECT NR+ PHY hello" sample, generalized
 * into a reusable transmit/receive interface for the mesh layer.
 */

#include "dect_phy.h"

#include <zephyr/kernel.h>
#include <zephyr/logging/log.h>
#include <zephyr/drivers/hwinfo.h>
#include <nrf_modem_dect_phy.h>
#include <modem/nrf_modem_lib.h>

LOG_MODULE_REGISTER(dect_phy, CONFIG_DECT_MESH_LOG_LEVEL);

BUILD_ASSERT(CONFIG_DECT_MESH_CARRIER,
	     "DECT NR+ carrier must be set per local regulations "
	     "(see overlay-eu.conf / overlay-us.conf)");

#define DECT_PHY_TX_HANDLE 0
#define DECT_PHY_RX_HANDLE 1

/* PHY header type 1. Due to endianness the field order differs from the spec. */
struct phy_ctrl_field_common {
	uint32_t packet_length : 4;
	uint32_t packet_length_type : 1;
	uint32_t header_format : 3;
	uint32_t short_network_id : 8;
	uint32_t transmitter_id_hi : 8;
	uint32_t transmitter_id_lo : 8;
	uint32_t df_mcs : 3;
	uint32_t reserved : 1;
	uint32_t transmit_power : 4;
	uint32_t pad : 24;
};

/* Synchronizes blocking calls with their completion event. */
static K_SEM_DEFINE(operation_sem, 0, 1);
static K_SEM_DEFINE(deinit_sem, 0, 1);

static uint16_t phy_device_id;
static uint64_t modem_time;
static bool init_failed;
static dect_phy_rx_cb_t rx_cb;

/* Transmitter ID from the most recent control-channel header, paired with the
 * data-channel payload that follows it. Both are accessed only from the modem
 * event-handler context, so no additional locking is required.
 */
static uint16_t last_pcc_tx_id;

static const struct nrf_modem_dect_phy_config_params config_params = {
	.band_group_index =
		((CONFIG_DECT_MESH_CARRIER >= 525 && CONFIG_DECT_MESH_CARRIER <= 551)) ? 1 : 0,
	.harq_rx_process_count = 4,
	.harq_rx_expiry_time_us = 5000000,
};

static void on_init(const struct nrf_modem_dect_phy_init_event *evt)
{
	if (evt->err) {
		LOG_ERR("Init failed, err %d", evt->err);
		init_failed = true;
		return;
	}

	k_sem_give(&operation_sem);
}

static void on_configure(const struct nrf_modem_dect_phy_configure_event *evt)
{
	if (evt->err) {
		LOG_ERR("Configure failed, err %d", evt->err);
		init_failed = true;
		return;
	}

	k_sem_give(&operation_sem);
}

static void on_activate(const struct nrf_modem_dect_phy_activate_event *evt)
{
	if (evt->err) {
		LOG_ERR("Activate failed, err %d", evt->err);
		init_failed = true;
		return;
	}

	k_sem_give(&operation_sem);
}

static void on_op_complete(const struct nrf_modem_dect_phy_op_complete_event *evt)
{
	LOG_DBG("op_complete time %" PRIu64 " status %d", modem_time, evt->err);
	k_sem_give(&operation_sem);
}

static void on_cancel(const struct nrf_modem_dect_phy_cancel_event *evt)
{
	LOG_DBG("cancel status %d", evt->err);
	k_sem_give(&operation_sem);
}

/* Control-channel reception: remember who is transmitting this frame. */
static void on_pcc(const struct nrf_modem_dect_phy_pcc_event *evt)
{
	last_pcc_tx_id = (uint16_t)(evt->hdr.hdr_type_1.transmitter_id_hi << 8 |
				    evt->hdr.hdr_type_1.transmitter_id_lo);
}

/* Data-channel reception: deliver the payload to the application. */
static void on_pdc(const struct nrf_modem_dect_phy_pdc_event *evt)
{
	/* RSSI-2 is in dBm with 0.5 dBm resolution (Q14.1). */
	int16_t rssi_dbm = evt->rssi_2 / 2;

	if (rx_cb != NULL && evt->data != NULL && evt->len > 0) {
		rx_cb((const uint8_t *)evt->data, evt->len, rssi_dbm, last_pcc_tx_id);
	}
}

static void dect_phy_event_handler(const struct nrf_modem_dect_phy_event *evt)
{
	modem_time = evt->time;

	switch (evt->id) {
	case NRF_MODEM_DECT_PHY_EVT_INIT:
		on_init(&evt->init);
		break;
	case NRF_MODEM_DECT_PHY_EVT_CONFIGURE:
		on_configure(&evt->configure);
		break;
	case NRF_MODEM_DECT_PHY_EVT_ACTIVATE:
		on_activate(&evt->activate);
		break;
	case NRF_MODEM_DECT_PHY_EVT_COMPLETED:
		on_op_complete(&evt->op_complete);
		break;
	case NRF_MODEM_DECT_PHY_EVT_CANCELED:
		on_cancel(&evt->cancel);
		break;
	case NRF_MODEM_DECT_PHY_EVT_PCC:
		on_pcc(&evt->pcc);
		break;
	case NRF_MODEM_DECT_PHY_EVT_PDC:
		on_pdc(&evt->pdc);
		break;
	default:
		/* Remaining events (RSSI, capability, time, errors) are unused
		 * by the mesh and are intentionally ignored.
		 */
		break;
	}
}

void dect_phy_set_rx_cb(dect_phy_rx_cb_t cb)
{
	rx_cb = cb;
}

int dect_phy_init(uint16_t *device_id)
{
	int err;

	err = nrf_modem_lib_init();
	if (err) {
		LOG_ERR("nrf_modem_lib_init failed, err %d", err);
		return err;
	}

	err = nrf_modem_dect_phy_event_handler_set(dect_phy_event_handler);
	if (err) {
		LOG_ERR("nrf_modem_dect_phy_event_handler_set failed, err %d", err);
		return err;
	}

	err = nrf_modem_dect_phy_init();
	if (err) {
		LOG_ERR("nrf_modem_dect_phy_init failed, err %d", err);
		return err;
	}

	k_sem_take(&operation_sem, K_FOREVER);
	if (init_failed) {
		return -EIO;
	}

	err = nrf_modem_dect_phy_configure(&config_params);
	if (err) {
		LOG_ERR("nrf_modem_dect_phy_configure failed, err %d", err);
		return err;
	}

	k_sem_take(&operation_sem, K_FOREVER);
	if (init_failed) {
		return -EIO;
	}

	err = nrf_modem_dect_phy_activate(NRF_MODEM_DECT_PHY_RADIO_MODE_LOW_LATENCY);
	if (err) {
		LOG_ERR("nrf_modem_dect_phy_activate failed, err %d", err);
		return err;
	}

	k_sem_take(&operation_sem, K_FOREVER);
	if (init_failed) {
		return -EIO;
	}

	/* Derive the PHY device ID from the hardware ID. */
	hwinfo_get_device_id((void *)&phy_device_id, sizeof(phy_device_id));

	if (device_id != NULL) {
		*device_id = phy_device_id;
	}

	LOG_INF("DECT NR+ PHY ready, device ID %u, carrier %d", phy_device_id,
		CONFIG_DECT_MESH_CARRIER);

	return 0;
}

int dect_phy_tx(const uint8_t *data, size_t len)
{
	int err;

	struct phy_ctrl_field_common header = {
		.header_format = 0x0,
		.packet_length_type = 0x0,
		.packet_length = 0x01,
		.short_network_id = (CONFIG_DECT_MESH_NETWORK_ID & 0xff),
		.transmitter_id_hi = (phy_device_id >> 8),
		.transmitter_id_lo = (phy_device_id & 0xff),
		.transmit_power = CONFIG_DECT_MESH_TX_POWER,
		.reserved = 0,
		.df_mcs = CONFIG_DECT_MESH_MCS,
	};

	struct nrf_modem_dect_phy_tx_params tx_op_params = {
		.start_time = 0,
		.handle = DECT_PHY_TX_HANDLE,
		.network_id = CONFIG_DECT_MESH_NETWORK_ID,
		.phy_type = 0,
		.lbt_rssi_threshold_max = 0,
		.carrier = CONFIG_DECT_MESH_CARRIER,
		.lbt_period = NRF_MODEM_DECT_LBT_PERIOD_MAX,
		.phy_header = (union nrf_modem_dect_phy_hdr *)&header,
		.data = (void *)data,
		.data_size = len,
	};

	err = nrf_modem_dect_phy_tx(&tx_op_params);
	if (err) {
		LOG_ERR("nrf_modem_dect_phy_tx failed, err %d", err);
		return err;
	}

	/* Wait for the transmit operation to complete. */
	k_sem_take(&operation_sem, K_FOREVER);

	return 0;
}

int dect_phy_rx_window(uint32_t duration_seconds)
{
	int err;

	struct nrf_modem_dect_phy_rx_params rx_op_params = {
		.start_time = 0,
		.handle = DECT_PHY_RX_HANDLE,
		.network_id = CONFIG_DECT_MESH_NETWORK_ID,
		.mode = NRF_MODEM_DECT_PHY_RX_MODE_CONTINUOUS,
		.rssi_interval = NRF_MODEM_DECT_PHY_RSSI_INTERVAL_OFF,
		.link_id = NRF_MODEM_DECT_PHY_LINK_UNSPECIFIED,
		.rssi_level = -60,
		.carrier = CONFIG_DECT_MESH_CARRIER,
		.duration = (uint64_t)duration_seconds * MSEC_PER_SEC *
			    NRF_MODEM_DECT_MODEM_TIME_TICK_RATE_KHZ,
		.filter.short_network_id = CONFIG_DECT_MESH_NETWORK_ID & 0xff,
		.filter.is_short_network_id_used = 1,
		/* Receive from any transmitter (broadcast flooding). */
		.filter.receiver_identity = 0,
	};

	err = nrf_modem_dect_phy_rx(&rx_op_params);
	if (err) {
		LOG_ERR("nrf_modem_dect_phy_rx failed, err %d", err);
		return err;
	}

	/* Wait for the receive window to elapse. */
	k_sem_take(&operation_sem, K_FOREVER);

	return 0;
}
```

## src/dect_phy.h
```c
/*
 * Copyright (c) 2026 Jon Sharp
 *
 * SPDX-License-Identifier: Apache-2.0
 */

#ifndef DECT_PHY_H_
#define DECT_PHY_H_

#include <stdint.h>
#include <stddef.h>

/**
 * @file
 * @brief Thin wrapper around the DECT NR+ PHY modem API.
 *
 * Hides the init/configure/activate handshake and the event-handler plumbing,
 * and exposes a simple blocking transmit plus a continuous receive window. Each
 * decoded data frame is delivered to a registered callback. The wrapper is
 * single-radio and half-duplex: transmit while no receive window is open, then
 * open a receive window to collect inbound frames.
 */

/**
 * @brief Callback invoked for every successfully decoded DECT NR+ data frame.
 *
 * Called from the modem event-handler context. Keep the work short and
 * non-blocking; queue the frame for processing on an application thread.
 *
 * @param data        Pointer to the received payload (valid only for the call).
 * @param len         Payload length in bytes.
 * @param rssi_dbm    Received signal strength in dBm.
 * @param last_hop_id PHY transmitter ID of the immediate sender (last hop).
 */
typedef void (*dect_phy_rx_cb_t)(const uint8_t *data, size_t len, int16_t rssi_dbm,
				 uint16_t last_hop_id);

/**
 * @brief Initialize the modem and bring up the DECT NR+ PHY.
 *
 * Runs the full init, configure and activate handshake, blocking until each
 * step completes.
 *
 * @param device_id Output: the PHY device ID derived from the hardware ID.
 *
 * @retval 0 on success, negative errno otherwise.
 */
int dect_phy_init(uint16_t *device_id);

/**
 * @brief Register the receive callback.
 *
 * @param cb Callback to invoke per decoded frame, or NULL to disable.
 */
void dect_phy_set_rx_cb(dect_phy_rx_cb_t cb);

/**
 * @brief Transmit one DECT NR+ data frame and block until the operation ends.
 *
 * @param data Payload to send.
 * @param len  Payload length in bytes.
 *
 * @retval 0 on success, negative errno otherwise.
 */
int dect_phy_tx(const uint8_t *data, size_t len);

/**
 * @brief Open a continuous receive window and block until it ends.
 *
 * Decoded frames are delivered to the registered receive callback while the
 * window is open.
 *
 * @param duration_seconds Receive window duration in seconds.
 *
 * @retval 0 on success, negative errno otherwise.
 */
int dect_phy_rx_window(uint32_t duration_seconds);

#endif /* DECT_PHY_H_ */
```

## src/mesh.c
```c
/*
 * Copyright (c) 2026 Jon Sharp
 *
 * SPDX-License-Identifier: Apache-2.0
 *
 * Controlled-flood multi-hop mesh over the DECT NR+ PHY broadcast channel.
 */

#include "mesh.h"
#include "mesh_metrics.h"

#include <string.h>
#include <stdio.h>
#include <zephyr/kernel.h>
#include <zephyr/logging/log.h>
#include <zephyr/sys/byteorder.h>

LOG_MODULE_REGISTER(mesh, CONFIG_DECT_MESH_LOG_LEVEL);

#define MESH_MAGIC 0x4dU /* 'M' */
#define MESH_PROTO_VERSION 1U
#define MESH_BROADCAST_ID 0xffffU

/** Mesh frame header. Multi-byte fields are little-endian on the wire. */
struct mesh_hdr {
	uint8_t magic;
	uint8_t version;
	uint8_t msg_type;
	uint8_t ttl;
	uint8_t hop_count;
	uint8_t payload_len;
	uint16_t src_id;
	uint16_t dest_id;
	uint16_t msg_id;
} __packed;

#define MESH_HDR_LEN (sizeof(struct mesh_hdr))
#define MESH_MAX_PAYLOAD (MESH_FRAME_MAX - MESH_HDR_LEN)

enum mesh_msg_type {
	MESH_MSG_DATA = 1,
};

struct mesh_rx_frame {
	uint8_t data[MESH_FRAME_MAX];
	uint8_t len;
	int16_t rssi_dbm;
	uint16_t last_hop_id;
};

struct mesh_tx_frame {
	uint8_t data[MESH_FRAME_MAX];
	uint8_t len;
};

struct dedup_entry {
	uint16_t src_id;
	uint16_t msg_id;
	bool valid;
};

struct neighbor {
	uint16_t id;
	int16_t rssi_dbm;
	int64_t last_seen_ms;
	uint32_t rx_count;
	bool valid;
};

K_MSGQ_DEFINE(rx_msgq, sizeof(struct mesh_rx_frame), CONFIG_DECT_MESH_RX_QUEUE_DEPTH, 4);
K_MSGQ_DEFINE(tx_msgq, sizeof(struct mesh_tx_frame), CONFIG_DECT_MESH_TX_QUEUE_DEPTH, 4);

static uint16_t self_id;
static uint16_t tx_seq;
static int64_t next_originate_ms;

/* Ring buffer of recently seen (src_id, msg_id) pairs for loop suppression. */
static struct dedup_entry dedup_cache[CONFIG_DECT_MESH_DEDUP_CACHE_SIZE];
static uint16_t dedup_head;

static struct neighbor neighbors[CONFIG_DECT_MESH_MAX_NEIGHBORS];

/* Inbound-queue overflow counter, incremented from modem context. */
static atomic_t rx_overflow;

/**
 * @brief Test whether a (src, msg) pair was seen before; record it if not.
 *
 * @return true if the pair was already present (a duplicate).
 */
static bool dedup_seen_or_record(uint16_t src_id, uint16_t msg_id)
{
	for (size_t i = 0; i < ARRAY_SIZE(dedup_cache); i++) {
		if (dedup_cache[i].valid && dedup_cache[i].src_id == src_id &&
		    dedup_cache[i].msg_id == msg_id) {
			return true;
		}
	}

	dedup_cache[dedup_head].src_id = src_id;
	dedup_cache[dedup_head].msg_id = msg_id;
	dedup_cache[dedup_head].valid = true;
	dedup_head = (dedup_head + 1) % ARRAY_SIZE(dedup_cache);

	return false;
}

static void neighbor_update(uint16_t id, int16_t rssi_dbm)
{
	int64_t now = k_uptime_get();
	struct neighbor *slot = NULL;
	struct neighbor *oldest = &neighbors[0];

	for (size_t i = 0; i < ARRAY_SIZE(neighbors); i++) {
		if (neighbors[i].valid && neighbors[i].id == id) {
			slot = &neighbors[i];
			break;
		}
		if (!neighbors[i].valid) {
			slot = &neighbors[i];
			break;
		}
		if (neighbors[i].last_seen_ms < oldest->last_seen_ms) {
			oldest = &neighbors[i];
		}
	}

	/* Table full of other neighbors: evict the least recently seen. */
	if (slot == NULL) {
		slot = oldest;
		slot->rx_count = 0;
	}

	if (!slot->valid || slot->id != id) {
		slot->id = id;
		slot->rx_count = 0;
		slot->valid = true;
	}

	slot->rssi_dbm = rssi_dbm;
	slot->last_seen_ms = now;
	slot->rx_count++;
}

static uint8_t neighbor_active_count(void)
{
	int64_t now = k_uptime_get();
	int64_t timeout_ms = (int64_t)CONFIG_DECT_MESH_NEIGHBOR_TIMEOUT_SECONDS * MSEC_PER_SEC;
	uint8_t count = 0;

	for (size_t i = 0; i < ARRAY_SIZE(neighbors); i++) {
		if (neighbors[i].valid && (now - neighbors[i].last_seen_ms) <= timeout_ms) {
			count++;
		}
	}

	return count;
}

static int tx_enqueue(const struct mesh_hdr *hdr, const uint8_t *payload, uint8_t payload_len)
{
	struct mesh_tx_frame frame;

	if (MESH_HDR_LEN + payload_len > MESH_FRAME_MAX) {
		return -EMSGSIZE;
	}

	memcpy(frame.data, hdr, MESH_HDR_LEN);
	if (payload_len > 0) {
		memcpy(frame.data + MESH_HDR_LEN, payload, payload_len);
	}
	frame.len = MESH_HDR_LEN + payload_len;

	if (k_msgq_put(&tx_msgq, &frame, K_NO_WAIT) != 0) {
		LOG_WRN("TX queue full, dropping frame");
		return -ENOMEM;
	}

	return 0;
}

static int mesh_send(uint16_t dest_id, const uint8_t *payload, uint8_t payload_len)
{
	struct mesh_hdr hdr = {
		.magic = MESH_MAGIC,
		.version = MESH_PROTO_VERSION,
		.msg_type = MESH_MSG_DATA,
		.ttl = CONFIG_DECT_MESH_DEFAULT_TTL,
		.hop_count = 0,
		.payload_len = payload_len,
		.src_id = sys_cpu_to_le16(self_id),
		.dest_id = sys_cpu_to_le16(dest_id),
		.msg_id = sys_cpu_to_le16(++tx_seq),
	};

	/* Suppress relaying our own frame if it floods back to us. */
	(void)dedup_seen_or_record(self_id, tx_seq);

	LOG_INF("Originate msg_id %u -> 0x%04x (ttl %u): \"%.*s\"", tx_seq, dest_id,
		CONFIG_DECT_MESH_DEFAULT_TTL, payload_len, payload);

	mesh_metrics_record_originated();

	return tx_enqueue(&hdr, payload, payload_len);
}

static void relay_frame(const struct mesh_hdr *in_hdr, const uint8_t *payload)
{
	struct mesh_hdr hdr = *in_hdr;

	hdr.ttl = in_hdr->ttl - 1;
	hdr.hop_count = in_hdr->hop_count + 1;

	if (tx_enqueue(&hdr, payload, in_hdr->payload_len) == 0) {
		LOG_DBG("Relay msg_id %u (ttl %u, hop %u)", sys_le16_to_cpu(in_hdr->msg_id),
			hdr.ttl, hdr.hop_count);
		mesh_metrics_record_relayed();
	}
}

static void process_frame(const struct mesh_rx_frame *frame)
{
	const struct mesh_hdr *hdr;
	const uint8_t *payload;
	uint16_t src_id;
	uint16_t dest_id;
	uint16_t msg_id;
	bool for_me;
	bool is_broadcast;

	if (frame->len < MESH_HDR_LEN) {
		LOG_DBG("Runt frame (%u bytes), dropping", frame->len);
		return;
	}

	hdr = (const struct mesh_hdr *)frame->data;
	if (hdr->magic != MESH_MAGIC || hdr->version != MESH_PROTO_VERSION) {
		LOG_DBG("Foreign frame (magic 0x%02x ver %u), dropping", hdr->magic, hdr->version);
		return;
	}

	if (MESH_HDR_LEN + hdr->payload_len > frame->len) {
		LOG_DBG("Truncated payload, dropping");
		return;
	}

	payload = frame->data + MESH_HDR_LEN;
	src_id = sys_le16_to_cpu(hdr->src_id);
	dest_id = sys_le16_to_cpu(hdr->dest_id);
	msg_id = sys_le16_to_cpu(hdr->msg_id);

	/* The immediate sender is a one-hop neighbor; record link quality. */
	neighbor_update(frame->last_hop_id, frame->rssi_dbm);
	mesh_metrics_record_rx(frame->rssi_dbm, hdr->hop_count + 1);

	/* Our own frame looped back. */
	if (src_id == self_id) {
		return;
	}

	/* Already relayed/delivered this message: suppress the loop. */
	if (dedup_seen_or_record(src_id, msg_id)) {
		LOG_DBG("Duplicate msg_id %u from 0x%04x, dropping", msg_id, src_id);
		mesh_metrics_record_dup_dropped();
		return;
	}

	is_broadcast = (dest_id == MESH_BROADCAST_ID);
	for_me = (dest_id == self_id);

	if (for_me || is_broadcast) {
		LOG_INF("Deliver msg_id %u from 0x%04x (%u hops, RSSI %d dBm): \"%.*s\"", msg_id,
			src_id, hdr->hop_count + 1, frame->rssi_dbm, hdr->payload_len, payload);
		mesh_metrics_record_delivered();
	}

	/* Relay onwards unless it was a unicast addressed to us, while TTL allows. */
	if (!for_me && hdr->ttl > 1) {
		relay_frame(hdr, payload);
	}
}

static void maybe_originate(void)
{
	uint8_t payload[MESH_MAX_PAYLOAD];
	int len;

	if (CONFIG_DECT_MESH_ORIGINATE_INTERVAL_SECONDS == 0) {
		return;
	}

	if (k_uptime_get() < next_originate_ms) {
		return;
	}

	next_originate_ms =
		k_uptime_get() + (int64_t)CONFIG_DECT_MESH_ORIGINATE_INTERVAL_SECONDS * MSEC_PER_SEC;

	len = snprintf((char *)payload, sizeof(payload), "node %04x #%u", self_id, tx_seq + 1);
	if (len < 0 || len > (int)sizeof(payload)) {
		return;
	}

	(void)mesh_send(MESH_BROADCAST_ID, payload, (uint8_t)len);
}

void mesh_rx_enqueue(const uint8_t *data, size_t len, int16_t rssi_dbm, uint16_t last_hop_id)
{
	struct mesh_rx_frame frame;

	if (len > MESH_FRAME_MAX) {
		len = MESH_FRAME_MAX;
	}

	memcpy(frame.data, data, len);
	frame.len = (uint8_t)len;
	frame.rssi_dbm = rssi_dbm;
	frame.last_hop_id = last_hop_id;

	if (k_msgq_put(&rx_msgq, &frame, K_NO_WAIT) != 0) {
		atomic_inc(&rx_overflow);
	}
}

void mesh_process(void)
{
	struct mesh_rx_frame frame;
	atomic_val_t dropped;

	while (k_msgq_get(&rx_msgq, &frame, K_NO_WAIT) == 0) {
		process_frame(&frame);
	}

	dropped = atomic_clear(&rx_overflow);
	if (dropped > 0) {
		LOG_WRN("Dropped %ld inbound frames (RX queue overflow)", (long)dropped);
	}

	maybe_originate();
	mesh_metrics_set_neighbor_count(neighbor_active_count());
}

size_t mesh_tx_dequeue(uint8_t *out_buf, size_t out_buf_size)
{
	struct mesh_tx_frame frame;

	if (k_msgq_get(&tx_msgq, &frame, K_NO_WAIT) != 0) {
		return 0;
	}

	if (frame.len > out_buf_size) {
		LOG_ERR("Outbound frame (%u) exceeds buffer (%zu)", frame.len, out_buf_size);
		return 0;
	}

	memcpy(out_buf, frame.data, frame.len);

	return frame.len;
}

void mesh_init(uint16_t node_id)
{
	self_id = node_id;
	tx_seq = 0;
	dedup_head = 0;
	next_originate_ms = 0;
	atomic_clear(&rx_overflow);
	memset(dedup_cache, 0, sizeof(dedup_cache));
	memset(neighbors, 0, sizeof(neighbors));

	BUILD_ASSERT(MESH_HDR_LEN < MESH_FRAME_MAX, "Mesh header exceeds frame budget");

	LOG_INF("Mesh node 0x%04x up (TTL %u, frame max %u, payload max %u)", node_id,
		CONFIG_DECT_MESH_DEFAULT_TTL, MESH_FRAME_MAX, (unsigned int)MESH_MAX_PAYLOAD);
}
```

## src/mesh.h
```c
/*
 * Copyright (c) 2026 Jon Sharp
 *
 * SPDX-License-Identifier: Apache-2.0
 */

#ifndef MESH_H_
#define MESH_H_

#include <stdint.h>
#include <stddef.h>

/**
 * @file
 * @brief Application-layer multi-hop relay over the DECT NR+ PHY.
 *
 * Implements a controlled-flood mesh on top of the broadcast PHY: every node is
 * a peer that re-transmits frames it has not seen before, bounded by a
 * time-to-live (TTL) hop count and a duplicate-suppression cache. A neighbor
 * table is maintained from the link quality of directly received frames.
 *
 * The mesh owns two queues. Inbound frames are enqueued from the PHY receive
 * callback (modem context) and processed later on the application thread;
 * outbound frames (originations and relays) are produced on the application
 * thread and drained by the caller for transmission. All mesh state is touched
 * only from the application thread, so it needs no locking.
 */

/** Maximum on-air frame size, in bytes (PHY payload budget). */
#define MESH_FRAME_MAX 32U

/**
 * @brief Initialize the mesh with this node's address.
 *
 * @param node_id Address used as the originator ID and to recognize frames
 *                addressed to, or originated by, this node.
 */
void mesh_init(uint16_t node_id);

/**
 * @brief Enqueue a raw frame received from the PHY.
 *
 * Safe to call from the PHY receive callback context. Does not process the
 * frame; @ref mesh_process performs the mesh logic on the application thread.
 *
 * @param data        Received payload.
 * @param len         Payload length in bytes.
 * @param rssi_dbm    Link RSSI in dBm.
 * @param last_hop_id PHY transmitter ID of the immediate sender.
 */
void mesh_rx_enqueue(const uint8_t *data, size_t len, int16_t rssi_dbm, uint16_t last_hop_id);

/**
 * @brief Run one mesh service pass on the application thread.
 *
 * Drains and processes queued inbound frames (delivering local messages and
 * scheduling relays), originates a new message if the origination interval has
 * elapsed, and refreshes the neighbor-count metric.
 */
void mesh_process(void);

/**
 * @brief Dequeue the next outbound frame for transmission.
 *
 * @param out_buf      Destination buffer.
 * @param out_buf_size Size of @p out_buf in bytes.
 *
 * @return Frame length in bytes, or 0 if no frame is pending.
 */
size_t mesh_tx_dequeue(uint8_t *out_buf, size_t out_buf_size);

#endif /* MESH_H_ */
```

## src/mesh_metrics.c
```c
/*
 * Copyright (c) 2026 Jon Sharp
 *
 * SPDX-License-Identifier: Apache-2.0
 *
 * Memfault device identity and custom mesh metrics. All Memfault calls are
 * guarded so the mesh builds with or without CONFIG_MEMFAULT.
 */

#include "mesh_metrics.h"

#include <stdio.h>
#include <zephyr/kernel.h>
#include <zephyr/logging/log.h>

#if defined(CONFIG_MEMFAULT)
#include <memfault/metrics/metrics.h>
#include <memfault_ncs.h>
#endif

LOG_MODULE_REGISTER(mesh_metrics, CONFIG_DECT_MESH_LOG_LEVEL);

/* Highest hop count observed so far, reported as a gauge. */
static uint8_t max_hops_seen;

void mesh_metrics_set_device_id(uint16_t node_id)
{
#if defined(CONFIG_MEMFAULT) && defined(CONFIG_MEMFAULT_NCS_DEVICE_ID_RUNTIME)
	char device_id[16];
	int len;
	int err;

	len = snprintf(device_id, sizeof(device_id), "dect-mesh-%04x", node_id);
	if (len <= 0 || len >= (int)sizeof(device_id)) {
		LOG_ERR("Failed to format device ID");
		return;
	}

	err = memfault_ncs_device_id_set(device_id, len);
	if (err) {
		LOG_ERR("memfault_ncs_device_id_set failed, err %d", err);
		return;
	}

	LOG_INF("Memfault device ID: %s", device_id);
#else
	ARG_UNUSED(node_id);
#endif
}

void mesh_metrics_record_originated(void)
{
#if defined(CONFIG_MEMFAULT)
	MEMFAULT_METRIC_ADD(dect_originated, 1);
#endif
}

void mesh_metrics_record_relayed(void)
{
#if defined(CONFIG_MEMFAULT)
	MEMFAULT_METRIC_ADD(dect_relayed, 1);
#endif
}

void mesh_metrics_record_delivered(void)
{
#if defined(CONFIG_MEMFAULT)
	MEMFAULT_METRIC_ADD(dect_delivered, 1);
#endif
}

void mesh_metrics_record_dup_dropped(void)
{
#if defined(CONFIG_MEMFAULT)
	MEMFAULT_METRIC_ADD(dect_dups_dropped, 1);
#endif
}

void mesh_metrics_record_tx_failure(void)
{
#if defined(CONFIG_MEMFAULT)
	MEMFAULT_METRIC_ADD(dect_tx_failures, 1);
#endif
}

void mesh_metrics_record_rx(int16_t rssi_dbm, uint8_t hops)
{
	if (hops > max_hops_seen) {
		max_hops_seen = hops;
	}

#if defined(CONFIG_MEMFAULT)
	MEMFAULT_METRIC_SET_SIGNED(dect_rx_rssi_dbm, rssi_dbm);
	MEMFAULT_METRIC_SET_UNSIGNED(dect_max_hops, max_hops_seen);
#else
	ARG_UNUSED(rssi_dbm);
#endif
}

void mesh_metrics_set_neighbor_count(uint8_t count)
{
#if defined(CONFIG_MEMFAULT)
	MEMFAULT_METRIC_SET_UNSIGNED(dect_neighbors, count);
#else
	ARG_UNUSED(count);
#endif
}
```

## src/mesh_metrics.h
```c
/*
 * Copyright (c) 2026 Jon Sharp
 *
 * SPDX-License-Identifier: Apache-2.0
 */

#ifndef MESH_METRICS_H_
#define MESH_METRICS_H_

#include <stdint.h>

/**
 * @file
 * @brief Memfault integration for the DECT NR+ mesh.
 *
 * Sets the Memfault device identity from the mesh node ID and records custom
 * mesh metrics into the Memfault heartbeat. When @c CONFIG_MEMFAULT is
 * disabled, every entry point compiles to a no-op so the mesh builds without
 * the Memfault SDK.
 */

/**
 * @brief Set the Memfault device serial to "dect-mesh-<node_id>".
 *
 * @param node_id Mesh node address.
 */
void mesh_metrics_set_device_id(uint16_t node_id);

/** Record that this node originated a new message. */
void mesh_metrics_record_originated(void);

/** Record that this node relayed a message onward. */
void mesh_metrics_record_relayed(void);

/** Record that a message was delivered to this node. */
void mesh_metrics_record_delivered(void);

/** Record that a duplicate frame was suppressed. */
void mesh_metrics_record_dup_dropped(void);

/** Record a failed PHY transmission. */
void mesh_metrics_record_tx_failure(void);

/**
 * @brief Record a received frame's link quality and observed hop count.
 *
 * @param rssi_dbm Link RSSI in dBm.
 * @param hops     Hops traversed by the frame so far.
 */
void mesh_metrics_record_rx(int16_t rssi_dbm, uint8_t hops);

/**
 * @brief Update the current active-neighbor count gauge.
 *
 * @param count Number of neighbors seen within the inactivity timeout.
 */
void mesh_metrics_set_neighbor_count(uint8_t count);

#endif /* MESH_METRICS_H_ */
```
